/*
 * Copyright (c) 2024 Henrik Brix Andersen <henrik@brixandersen.dk>
 *
 * SPDX-License-Identifier: Apache-2.0
 */

/ {
	aliases {
		mcuboot-led0 = &red_led_1;
		mcuboot-button0 = &user_button;
  };
};

